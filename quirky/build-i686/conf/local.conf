## quirky/meta-kirkstone/conf/layer.conf
```bitbake
# BK 2022-03-04

# We have a conf and classes directory, append to BBPATH
BBPATH .= ":${LAYERDIR}"

# We have a recipes directory, add to BBFILES
BBFILES += "${LAYERDIR}/recipes-*/*/*.bb ${LAYERDIR}/recipes-*/*/*.bbappend"

BBFILE_COLLECTIONS += "kirkstone"
BBFILE_PATTERN_kirkstone := "^${LAYERDIR}/"

# Define the priority for recipes (.bb files) from this layer,
# choosing carefully how this layer interacts with all of the
# other layers.
BBFILE_PRIORITY_kirkstone = "9"

# This should only be incremented on significant changes that will
# cause compatibility issues with other layers
LAYERVERSION_kirkstone = "1"

LAYERDEPENDS_kirkstone = "core"

LAYERSERIES_COMPAT_kirkstone = "dunfell"
```

## quirky/meta-yocto-bsp/conf/machine/genericx86-64.conf
```bitbake
#@TYPE: Machine
#@NAME: Generic x86_64
#@DESCRIPTION: Machine configuration for generic x86_64 (64-bit) PCs and servers. Supports a moderately wide range of drivers that should boot and be usable on "typical" hardware.

DEFAULTTUNE = "nocona-64"
require conf/machine/include/tune-nocona.inc
require conf/machine/include/genericx86-common.inc

#BK 20220820 ref: include/genericx86-common.inc
MACHINE_FEATURES += "efi"
XSERVER += "xf86-video-modesetting"
IMAGE_FSTYPES += "wic wic.bmap"


SERIAL_CONSOLES_CHECK = "ttyS0"
#For runqemu
QB_SYSTEM_NAME = "qemu-system-x86_64"
```
